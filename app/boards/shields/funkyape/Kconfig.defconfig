## app/boards/shields/funkyape/Kconfig.defconfig
```kconfig
if SHIELD_FUNKYAPE_LEFT

config ZMK_KEYBOARD_NAME
    default "FunkyApeL"

config ZMK_SPLIT_ROLE_CENTRAL
    default y

endif


if SHIELD_FUNKYAPE_RIGHT

config ZMK_KEYBOARD_NAME
    default "FunkyApeR"

endif


if SHIELD_FUNKYAPE_LEFT || SHIELD_FUNKYAPE_RIGHT

config ZMK_SPLIT
    default y

endif
```

## app/boards/shields/funkyape/Kconfig.shield
```kconfig
config SHIELD_FUNKYAPE_LEFT
    def_bool $(shields_list_contains,funkyape_left)

config SHIELD_FUNKYAPE_RIGHT
    def_bool $(shields_list_contains,funkyape_right)
```
